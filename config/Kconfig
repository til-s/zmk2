## config/Kconfig
```kconfig
config ZMK_NUMLOCK_LAYER_LED
    bool "NumLock LED follows numlock layer state instead of host HID indicator"
    default y
    help
      Drive the NumLock LED directly from the ZMK numlock layer's
      active/inactive state, rather than from the host-reported HID
      NumLock indicator. This keeps the LED in sync with the actual
      keyboard-side layer, and guarantees the LED is off after a
      power cycle (since the layer resets to the default layer).
```

## config/boards/shields/tk_fcp026bk_v3/Kconfig.defconfig
```kconfig
if SHIELD_TK_FCP026BK_V3

config ZMK_KEYBOARD_NAME
    default "TK-FCP026BK_V3"

config ZMK_USB
    default y

config ZMK_BLE
    default y

# I2C（MCP23017接続用）
config I2C
    default y

# GPIO expander（MCP23017）
config GPIO_MCP230XX
    default y

# バッテリー残量レポート（Windows側でパーセント表示）
config ZMK_BATTERY_REPORTING
    default y

# HIDインジケーター（CapsLock / NumLock LEDに必要）
# ただし、NumLock LEDは別途独自に実装(ZMK_NUMLOCK_LAYER_LED)して対応
config ZMK_HID_INDICATORS
    default y

# NumLock LEDをホストのHID Indicatorではなく、numlock_layer(layer 2)の
# アクティブ状態から直接制御する(src/numlock_layer_led.cを利用)。
# if SHIELD_TK_FCP026BK_V3 ブロック内で宣言しているため、
# 暗黙的に「depends on SHIELD_TK_FCP026BK_V3」が付与され、v3以外では有効化されない。
config ZMK_NUMLOCK_LAYER_LED
    bool "NumLock LED follows numlock layer state instead of host HID indicator"
    default y

endif
```
